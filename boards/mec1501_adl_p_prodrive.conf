## boards/mec1501_adl_p_prodrive.conf
```kconfig
# Zephyr-based EC FW

# EC FW features configuration
# ----------------------------

CONFIG_PWRMGMT_DEEPSX=n

# Enable SMCHOST required for EC LPM
CONFIG_SMCHOST_EVENT_DRIVEN_TASK=y

# EC FW keyscan configuration
CONFIG_KSCAN=n
CONFIG_KSCAN_EC=n
CONFIG_KSCAN_XEC=n
CONFIG_ESPI_PERIPHERAL_8042_KBC=n
CONFIG_PS2_KEYBOARD=n
CONFIG_PS2_MOUSE=n

CONFIG_POSTCODE_MANAGEMENT=n
CONFIG_ESPI_PERIPHERAL_DEBUG_PORT_80=n

CONFIG_SOC_DEBUG_CONSENT_GPIO=y

# Support deprecated SMChost commands for backward compatibility
CONFIG_DEPRECATED_SMCHOST_CMD=y

# Zephyr kernel/driver configuration required by EC FW
# ----------------------------------------------------
# Enable additional drivers for ADL-P
CONFIG_PS2=n
CONFIG_ADC=n
CONFIG_ADC_XEC=n

# IO expander support
CONFIG_BOARD_ID_IO_EXPANDER=n
CONFIG_GPIO_PCA95XX=n
CONFIG_GPIO_PCA95XX_INTERRUPT=n

CONFIG_WAIT_FOR_PWROK=n

CONFIG_DNX_SUPPORT=n
CONFIG_LOG_OVERRIDE_LEVEL=2
CONFIG_EC_LOG_LEVEL=3
CONFIG_PERIPHERAL_LOG_LEVEL=4
CONFIG_BOARD_LOG_LEVEL=3
CONFIG_PWRMGT_LOG_LEVEL=4
#CONFIG_ESPIHUB_LOG_LEVEL=3
#CONFIG_SMCHOST_LOG_LEVEL=4

#CONFIG_VPD_PROGRAM_EEPROM=y
#CONFIG_VPD_SERIAL_NUMBER="TE-ST-SER-IAL"
#CONFIG_VPD_PART_NUMBER="ONE-FAKE-PART.NUM"
#CONFIG_VPD_PROFILE=0
```

## out_of_tree_boards/boards/arm/mec1501_adl_p_prodrive/Kconfig.board
```kconfig
# Copyright (c) 2022, Intel Corporation
# SPDX-License-Identifier: Apache-2.0

config BOARD_MEC1501_ADL_P_PRODRIVE
	bool "Prodrive MEC1501 ADL-P Atlas board"
	depends on SOC_MEC1501_HSZ
```

## out_of_tree_boards/boards/arm/mec1501_adl_p_prodrive/Kconfig.defconfig
```kconfig
# Copyright (c) 2022 Intel Corporation
# SPDX-License-Identifier: Apache-2.0

if BOARD_MEC1501_ADL_P_PRODRIVE

config BOARD
	default "mec1501_adl_p_prodrive"

#PS/2 driver is compiled in terms of this flag.
config ESPI_PERIPHERAL_8042_KBC
	default n
	depends on ESPI_XEC

if RTOS_TIMER

# XEC RTOS timer HW frequency is fixed at 32768
# The driver requires tickless mode and ticks per
# second to be 32768 for accurate operation.

config SYS_CLOCK_HW_CYCLES_PER_SEC
	default 32768

config SYS_CLOCK_TICKS_PER_SEC
	default 32768

endif # RTOS_TIMER

if !RTOS_TIMER

# If RTOS timer is not enabled we use ARM Cortex-M
# SYSTICK. SYSTICK frequency is 48MHz divided by
# SOC_MEC1501_PROC_CLK_DIV.

config SYS_CLOCK_HW_CYCLES_PER_SEC
	default 48000000

config SYS_CLOCK_TICKS_PER_SEC
	default 1000

endif # RTOS_TIMER

if SPI

config SPI_XEC_QMSPI
	default y

endif # SPI

config TACH_XEC
	default y
	depends on SENSOR

config WAIT_FOR_PWROK
	default y
	bool "Enable waiting for PWROK"

config VPD_PROGRAM_EEPROM
	bool "Program VPD data into EEPROM"
	default n
	help
	  Enable to program specific VPD data into the EEPROM. This option
	  should only be used to (re)provision the EEPROM, and must not be
	  enabled for board-agnostic production firmware.

comment "VPD fields"
	depends on VPD_PROGRAM_EEPROM

config VPD_SERIAL_NUMBER
	string "Prodrive VPD serial number"
	depends on VPD_PROGRAM_EEPROM
	default ""
	help
	  Serial number to program in VPD, leave empty to skip programming.

config VPD_PART_NUMBER
	string "Prodrive VPD part number"
	depends on VPD_PROGRAM_EEPROM
	default ""
	help
	  Part number to program in VPD, leave empty to skip programming.

config VPD_PROFILE
	int "Prodrive VPD profile"
	depends on VPD_PROGRAM_EEPROM
	default 0
	help
	  Profile to program in VPD, use 0 to skip programming.

endif # BOARD_MEC1501_ADL_PRODRIVE
```
